## main/Kconfig.projbuild
```kconfig
menu "M365 Dashboard"

    config M365_UART_DEVICE
        int
        default 0 if M365_UART_DEVICE0
        default 1 if M365_UART_DEVICE1
        default 2 if M365_UART_DEVICE2
        choice
            prompt "Select UART device for M365 communication"
            default M365_UART_DEVICE1

            config M365_UART_DEVICE0
                bool "UART 0"
            config M365_UART_DEVICE1
                bool "UART 1"
            config M365_UART_DEVICE2
                bool "UART 2"
        endchoice

    config M365_BUFF_SIZE
        int "Buffer size for M365 communication (bytes)"
        default 128

    config M365_TX_GPIO
        int "UART TX GPIO used for M365 communication"
        default 17

    config M365_RX_GPIO
        int "UART RX GPIO used for M365 communication"
        default 16

    config M365_TX_INTERVAL
        int "M365 transmission interval (ms)"
        default 50

    config M365_RX_TIMEOUT
        int "M365 response timeout (ms)"
        default 10

    config M365_ACCEL_CHANNEL
        int
        default 0 if M365_ACCEL_CHANNEL0
        default 1 if M365_ACCEL_CHANNEL1
        default 2 if M365_ACCEL_CHANNEL2
        default 3 if M365_ACCEL_CHANNEL3
        default 4 if M365_ACCEL_CHANNEL4
        default 5 if M365_ACCEL_CHANNEL5
        default 6 if M365_ACCEL_CHANNEL6
        default 7 if M365_ACCEL_CHANNEL7
        choice
            prompt "Select ADC channel for acceleration sensor"
            default M365_ACCEL_CHANNEL6

            config M365_ACCEL_CHANNEL0
                bool "ADC1_CH0 GPIO36"
            config M365_ACCEL_CHANNEL1
                bool "ADC1_CH1 GPIO37"
            config M365_ACCEL_CHANNEL2
                bool "ADC1_CH2 GPIO38"
            config M365_ACCEL_CHANNEL3
                bool "ADC1_CH3 GPIO39"
            config M365_ACCEL_CHANNEL4
                bool "ADC1_CH4 GPIO32"
            config M365_ACCEL_CHANNEL5
                bool "ADC1_CH5 GPIO33"
            config M365_ACCEL_CHANNEL6
                bool "ADC1_CH6 GPIO34"
            config M365_ACCEL_CHANNEL7
                bool "ADC1_CH7 GPIO35"
        endchoice

    config M365_BRAKE_CHANNEL
        int
        default 0 if M365_BRAKE_CHANNEL0
        default 1 if M365_BRAKE_CHANNEL1
        default 2 if M365_BRAKE_CHANNEL2
        default 3 if M365_BRAKE_CHANNEL3
        default 4 if M365_BRAKE_CHANNEL4
        default 5 if M365_BRAKE_CHANNEL5
        default 6 if M365_BRAKE_CHANNEL6
        default 7 if M365_BRAKE_CHANNEL7
        choice
            prompt "Select ADC channel for brake sensor"
            default M365_BRAKE_CHANNEL7

            config M365_BRAKE_CHANNEL0
                bool "ADC1_CH0 GPIO36"
            config M365_BRAKE_CHANNEL1
                bool "ADC1_CH1 GPIO37"
            config M365_BRAKE_CHANNEL2
                bool "ADC1_CH2 GPIO38"
            config M365_BRAKE_CHANNEL3
                bool "ADC1_CH3 GPIO39"
            config M365_BRAKE_CHANNEL4
                bool "ADC1_CH4 GPIO32"
            config M365_BRAKE_CHANNEL5
                bool "ADC1_CH5 GPIO33"
            config M365_BRAKE_CHANNEL6
                bool "ADC1_CH6 GPIO34"
            config M365_BRAKE_CHANNEL7
                bool "ADC1_CH7 GPIO35"
        endchoice

    config M365_ADC_MAX_THRESHOLD
        int "ADC MAX Threshold"
        range 40 194
        default 190
        help 
            If the acceleration/brake output is greater than this value,
            set the output to ADC_MAX. This exists so that the sensor
            noise won't matter when you have the throttle/brake hold down
            all the way.

    config M365_BUZZER_GPIO
        int "BUZZER GPIO"
        default 18

    config M365_BUZZER_FREQ
        int "Buzzer frequency"
        default 4000

    config M365_BEEP_DURATION
        int "Beep duration"
        default 500

    config M365_FRONT_LED_GPIO
        int "Front LED GPIO"
        default 12

    config M365_BUTTON_CTRL
        int "GPIO that controls center button behaviour"
        default 21

endmenu
```
